include "memory_regions.icf";

/* The memory information for each device is done in memory regions file.
 * The starting address and length of memory not defined in memory regions file are defined as 0. */

if (isdefinedsymbol(ATCM_START))
{
    define symbol ATCM_PRV_START = ATCM_START;
}
else
{
    define symbol ATCM_PRV_START = 0;
}

if (isdefinedsymbol(ATCM_LENGTH))
{
    define symbol ATCM_PRV_LENGTH = ATCM_LENGTH;
}
else
{
    define symbol ATCM_PRV_LENGTH = 0;
}

if (isdefinedsymbol(BTCM_START))
{
    define symbol BTCM_PRV_START = BTCM_START;
}
else
{
    define symbol BTCM_PRV_START = 0;
}

if (isdefinedsymbol(BTCM_LENGTH))
{
    define symbol BTCM_PRV_LENGTH = BTCM_LENGTH;
}
else
{
    define symbol BTCM_PRV_LENGTH = 0;
}

if (isdefinedsymbol(SYSTEM_RAM_START))
{
    define symbol SYSTEM_RAM_PRV_START = SYSTEM_RAM_START;
}
else
{
    define symbol SYSTEM_RAM_PRV_START = 0;
}

if (isdefinedsymbol(SYSTEM_RAM_LENGTH))
{
    define symbol SYSTEM_RAM_PRV_LENGTH = SYSTEM_RAM_LENGTH;
}
else
{
    define symbol SYSTEM_RAM_PRV_LENGTH = 0;
}

if (isdefinedsymbol(SYSTEM_RAM_MIRROR_START))
{
    define symbol SYSTEM_RAM_MIRROR_PRV_START = SYSTEM_RAM_MIRROR_START;
    define symbol HAS_SYSTEM_RAM_MIRROR = 1;
}
else
{
    define symbol SYSTEM_RAM_MIRROR_PRV_START = 0;
    define symbol HAS_SYSTEM_RAM_MIRROR = 0;
}

if (isdefinedsymbol(SYSTEM_RAM_MIRROR_LENGTH))
{
    define symbol SYSTEM_RAM_MIRROR_PRV_LENGTH = SYSTEM_RAM_MIRROR_LENGTH;
}
else
{
    define symbol SYSTEM_RAM_MIRROR_PRV_LENGTH = 0;
}

if (isdefinedsymbol(xSPI0_CS0_SPACE_MIRROR_START))
{
    define symbol xSPI0_CS0_SPACE_MIRROR_PRV_START = xSPI0_CS0_SPACE_MIRROR_START;
}
else
{
    define symbol xSPI0_CS0_SPACE_MIRROR_PRV_START = 0;
}

if (isdefinedsymbol(xSPI0_CS0_SPACE_MIRROR_LENGTH))
{
    define symbol xSPI0_CS0_SPACE_MIRROR_PRV_LENGTH = xSPI0_CS0_SPACE_MIRROR_LENGTH;
}
else
{
    define symbol xSPI0_CS0_SPACE_MIRROR_PRV_LENGTH = 0;
}

if (isdefinedsymbol(xSPI0_CS1_SPACE_MIRROR_START))
{
    define symbol xSPI0_CS1_SPACE_MIRROR_PRV_START = xSPI0_CS1_SPACE_MIRROR_START;
}
else
{
    define symbol xSPI0_CS1_SPACE_MIRROR_PRV_START = 0;
}

if (isdefinedsymbol(xSPI0_CS1_SPACE_MIRROR_LENGTH))
{
    define symbol xSPI0_CS1_SPACE_MIRROR_PRV_LENGTH = xSPI0_CS1_SPACE_MIRROR_LENGTH;
}
else
{
    define symbol xSPI0_CS1_SPACE_MIRROR_PRV_LENGTH = 0;
}

if (isdefinedsymbol(xSPI1_CS0_SPACE_MIRROR_START))
{
    define symbol xSPI1_CS0_SPACE_MIRROR_PRV_START = xSPI1_CS0_SPACE_MIRROR_START;
}
else
{
    define symbol xSPI1_CS0_SPACE_MIRROR_PRV_START = 0;
}

if (isdefinedsymbol(xSPI1_CS0_SPACE_MIRROR_LENGTH))
{
    define symbol xSPI1_CS0_SPACE_MIRROR_PRV_LENGTH = xSPI1_CS0_SPACE_MIRROR_LENGTH;
}
else
{
    define symbol xSPI1_CS0_SPACE_MIRROR_PRV_LENGTH = 0;
}

if (isdefinedsymbol(xSPI1_CS1_SPACE_MIRROR_START))
{
    define symbol xSPI1_CS1_SPACE_MIRROR_PRV_START = xSPI1_CS1_SPACE_MIRROR_START;
}
else
{
    define symbol xSPI1_CS1_SPACE_MIRROR_PRV_START = 0;
}

if (isdefinedsymbol(xSPI1_CS1_SPACE_MIRROR_LENGTH))
{
    define symbol xSPI1_CS1_SPACE_MIRROR_PRV_LENGTH = xSPI1_CS1_SPACE_MIRROR_LENGTH;
}
else
{
    define symbol xSPI1_CS1_SPACE_MIRROR_PRV_LENGTH = 0;
}

if (isdefinedsymbol(CS0_SPACE_MIRROR_START))
{
    define symbol CS0_SPACE_MIRROR_PRV_START = CS0_SPACE_MIRROR_START;
}
else
{
    define symbol CS0_SPACE_MIRROR_PRV_START = 0;
}

if (isdefinedsymbol(CS0_SPACE_MIRROR_LENGTH))
{
    define symbol CS0_SPACE_MIRROR_PRV_LENGTH = CS0_SPACE_MIRROR_LENGTH;
}
else
{
    define symbol CS0_SPACE_MIRROR_PRV_LENGTH = 0;
}

if (isdefinedsymbol(CS2_SPACE_MIRROR_START))
{
    define symbol CS2_SPACE_MIRROR_PRV_START = CS2_SPACE_MIRROR_START;
}
else
{
    define symbol CS2_SPACE_MIRROR_PRV_START = 0;
}

if (isdefinedsymbol(CS2_SPACE_MIRROR_LENGTH))
{
    define symbol CS2_SPACE_MIRROR_PRV_LENGTH = CS2_SPACE_MIRROR_LENGTH;
}
else
{
    define symbol CS2_SPACE_MIRROR_PRV_LENGTH = 0;
}


if (isdefinedsymbol(CS3_SPACE_MIRROR_START))
{
    define symbol CS3_SPACE_MIRROR_PRV_START = CS3_SPACE_MIRROR_START;
}
else
{
    define symbol CS3_SPACE_MIRROR_PRV_START = 0;
}

if (isdefinedsymbol(CS3_SPACE_MIRROR_LENGTH))
{
    define symbol CS3_SPACE_MIRROR_PRV_LENGTH = CS3_SPACE_MIRROR_LENGTH;
}
else
{
    define symbol CS3_SPACE_MIRROR_PRV_LENGTH = 0;
}

if (isdefinedsymbol(CS5_SPACE_MIRROR_START))
{
    define symbol CS5_SPACE_MIRROR_PRV_START = CS5_SPACE_MIRROR_START;
}
else
{
    define symbol CS5_SPACE_MIRROR_PRV_START = 0;
}

if (isdefinedsymbol(CS5_SPACE_MIRROR_LENGTH))
{
    define symbol CS5_SPACE_MIRROR_PRV_LENGTH = CS5_SPACE_MIRROR_LENGTH;
}
else
{
    define symbol CS5_SPACE_MIRROR_PRV_LENGTH = 0;
}


if (isdefinedsymbol(xSPI0_CS0_SPACE_START))
{
    define symbol xSPI0_CS0_SPACE_PRV_START = xSPI0_CS0_SPACE_START;
}
else
{
    define symbol xSPI0_CS0_SPACE_PRV_START = 0;
}

if (isdefinedsymbol(xSPI0_CS0_SPACE_LENGTH))
{
    define symbol xSPI0_CS0_SPACE_PRV_LENGTH = xSPI0_CS0_SPACE_LENGTH;
}
else
{
    define symbol xSPI0_CS0_SPACE_PRV_LENGTH = 0;
}

if (isdefinedsymbol(xSPI0_CS1_SPACE_START))
{
    define symbol xSPI0_CS1_SPACE_PRV_START = xSPI0_CS1_SPACE_START;
}
else
{
    define symbol xSPI0_CS1_SPACE_PRV_START = 0;
}

if (isdefinedsymbol(xSPI0_CS1_SPACE_LENGTH))
{
    define symbol xSPI0_CS1_SPACE_PRV_LENGTH = xSPI0_CS1_SPACE_LENGTH;
}
else
{
    define symbol xSPI0_CS1_SPACE_PRV_LENGTH = 0;
}

if (isdefinedsymbol(xSPI1_CS0_SPACE_START))
{
    define symbol xSPI1_CS0_SPACE_PRV_START = xSPI1_CS0_SPACE_START;
}
else
{
    define symbol xSPI1_CS0_SPACE_PRV_START = 0;
}

if (isdefinedsymbol(xSPI1_CS0_SPACE_LENGTH))
{
    define symbol xSPI1_CS0_SPACE_PRV_LENGTH = xSPI1_CS0_SPACE_LENGTH;
}
else
{
    define symbol xSPI1_CS0_SPACE_PRV_LENGTH = 0;
}

if (isdefinedsymbol(xSPI1_CS1_SPACE_START))
{
    define symbol xSPI1_CS1_SPACE_PRV_START = xSPI1_CS1_SPACE_START;
}
else
{
    define symbol xSPI1_CS1_SPACE_PRV_START = 0;
}

if (isdefinedsymbol(xSPI1_CS1_SPACE_LENGTH))
{
    define symbol xSPI1_CS1_SPACE_PRV_LENGTH = xSPI1_CS1_SPACE_LENGTH;
}
else
{
    define symbol xSPI1_CS1_SPACE_PRV_LENGTH = 0;
}

if (isdefinedsymbol(CS0_SPACE_START))
{
    define symbol CS0_SPACE_PRV_START = CS0_SPACE_START;
}
else
{
    define symbol CS0_SPACE_PRV_START = 0;
}

if (isdefinedsymbol(CS0_SPACE_LENGTH))
{
    define symbol CS0_SPACE_PRV_LENGTH = CS0_SPACE_LENGTH;
}
else
{
    define symbol CS0_SPACE_PRV_LENGTH = 0;
}

if (isdefinedsymbol(CS2_SPACE_START))
{
    define symbol CS2_SPACE_PRV_START = CS2_SPACE_START;
}
else
{
    define symbol CS2_SPACE_PRV_START = 0;
}

if (isdefinedsymbol(CS2_SPACE_LENGTH))
{
    define symbol CS2_SPACE_PRV_LENGTH = CS2_SPACE_LENGTH;
}
else
{
    define symbol CS2_SPACE_PRV_LENGTH = 0;
}

if (isdefinedsymbol(CS3_SPACE_START))
{
    define symbol CS3_SPACE_PRV_START = CS3_SPACE_START;
}
else
{
    define symbol CS3_SPACE_PRV_START = 0;
}

if (isdefinedsymbol(CS3_SPACE_LENGTH))
{
    define symbol CS3_SPACE_PRV_LENGTH = CS3_SPACE_LENGTH;
}
else
{
    define symbol CS3_SPACE_PRV_LENGTH = 0;
}

if (isdefinedsymbol(CS5_SPACE_START))
{
    define symbol CS5_SPACE_PRV_START = CS5_SPACE_START;
}
else
{
    define symbol CS5_SPACE_PRV_START = 0;
}

if (isdefinedsymbol(CS5_SPACE_LENGTH))
{
    define symbol CS5_SPACE_PRV_LENGTH = CS5_SPACE_LENGTH;
}
else
{
    define symbol CS5_SPACE_PRV_LENGTH = 0;
}

if ((0x00100000 == BTCM_PRV_START) && (0x10000000 == SYSTEM_RAM_PRV_START))
{
    define symbol _RZN_ORDINAL = 1;
}
else
{
    define symbol _RZN_ORDINAL = 2;
}

define symbol tmp_system_ram_start = SYSTEM_RAM_PRV_START % 0x20000;
define symbol tmp_system_ram_length = SYSTEM_RAM_PRV_LENGTH % 0x20000;

if (0 == tmp_system_ram_start)
{
    define symbol SYSTEM_RAM_ALIGN_START = SYSTEM_RAM_PRV_START;
}
else
{
    define symbol SYSTEM_RAM_ALIGN_START = SYSTEM_RAM_PRV_START + (0x20000 - tmp_system_ram_start);
}

if (0 == tmp_system_ram_length)
{
    define symbol SYSTEM_RAM_ALIGN_LENGTH = SYSTEM_RAM_PRV_LENGTH;
}
else
{
    define symbol SYSTEM_RAM_ALIGN_LENGTH = SYSTEM_RAM_PRV_LENGTH - tmp_system_ram_length;
}

if (1 == _RZN_ORDINAL)
{
    if (isdefinedsymbol(CR52_0))
    {
        define symbol INTVEC_ADDRESS                = SYSTEM_RAM_ALIGN_START;
        define symbol RAM_ADDRESS                   = (SYSTEM_RAM_ALIGN_START + 0x100);
        define symbol RAM_END_ADDRESS               = (SYSTEM_RAM_ALIGN_START + SYSTEM_RAM_ALIGN_LENGTH - 1);
        define symbol LOADER_STACK_ADDRESS          = (BTCM_PRV_START + 0x2000);
        define symbol LOADER_STACK_END_ADDRESS      = (BTCM_PRV_START + BTCM_PRV_LENGTH - 1);
    }
    else
    {
        define symbol INTVEC_ADDRESS                = SYSTEM_RAM_ALIGN_START;
        define symbol LOADER_STACK_ADDRESS          = (SYSTEM_RAM_ALIGN_START + 0x1000);
        define symbol LOADER_STACK_END_ADDRESS      = (SYSTEM_RAM_ALIGN_START + SYSTEM_RAM_ALIGN_LENGTH - 1);
        define symbol RAM_ADDRESS                   = (SYSTEM_RAM_ALIGN_START + 0x10000);
        define symbol RAM_END_ADDRESS               = (SYSTEM_RAM_ALIGN_START + SYSTEM_RAM_ALIGN_LENGTH - 1);
    }

    define symbol DATA_NONCACHE_OFFSET              = 0x00048000;
    define symbol DATA_NONCACHE_END_OFFSET          = 0x00044000;
    define symbol DMAC_LINK_MODE_OFFSET             = 0x00044000;
    define symbol DMAC_LINK_MODE_END_OFFSET         = 0x00040000;
    define symbol SHARED_NONCACHE_BUFFER_OFFSET     = 0x00040000;
    define symbol SHARED_NONCACHE_BUFFER_END_OFFSET = 0x00020000;
    define symbol NONCACHE_BUFFER_OFFSET            = 0x00020000;
    define symbol NONCACHE_BUFFER_END_OFFSET        = 0x00000000;
}
else
{
    define symbol INTVEC_ADDRESS                    = SYSTEM_RAM_ALIGN_START;
    define symbol LOADER_STACK_ADDRESS              = (SYSTEM_RAM_ALIGN_START + 0x1000);
    define symbol LOADER_STACK_END_ADDRESS          = (SYSTEM_RAM_ALIGN_START + SYSTEM_RAM_ALIGN_LENGTH - 1);
    define symbol RAM_ADDRESS                       = (SYSTEM_RAM_ALIGN_START + 0x10000);
    define symbol RAM_END_ADDRESS                   = (SYSTEM_RAM_ALIGN_START + SYSTEM_RAM_ALIGN_LENGTH - 1);

    define symbol NONCACHE_OFFSET                   = 0x00010000;
    define symbol NONCACHE_LENGTH                   = 0x00028000;
    define symbol SHARED_NONCACHE_BUFFER_OFFSET     = 0x00040000;
    define symbol SHARED_NONCACHE_BUFFER_END_OFFSET = 0x00020000;
}

if (0 == HAS_SYSTEM_RAM_MIRROR)
{
    if (isdefinedsymbol(CR52_0) || isdefinedsymbol(CR52_1))
    {
        define symbol SYSTEM_RAM_MIRROR_OFFSET      = 0x00000000;
    }
    else
    {
        define symbol SYSTEM_RAM_MIRROR_OFFSET      = 0x00200000;
    }
}
else
{
    define symbol SYSTEM_RAM_MIRROR_OFFSET          = 0x20000000;
}

/*###ICF### Section handled by ICF editor, don't touch! ****/
/*-Editor annotation file-*/
/* IcfEditorFile="$TOOLKIT_DIR$\config\ide\IcfEditor\a_v1_0.xml" */
/*-Specials-*/
define symbol __ICFEDIT_intvec_start__ = INTVEC_ADDRESS;
/*-Memory Regions-*/
define symbol __ICFEDIT_region_RAM_start__ = RAM_ADDRESS;
define symbol __ICFEDIT_region_RAM_end__   = RAM_END_ADDRESS;
/**** End of ICF editor section. ###ICF###*/

define memory mem with size = 4G;
define region RAM_region   = mem:[from __ICFEDIT_region_RAM_start__   to __ICFEDIT_region_RAM_end__];

define symbol __region_D_LOADER_STACK_start__ = LOADER_STACK_ADDRESS;
define symbol __region_D_LOADER_STACK_end__   = LOADER_STACK_END_ADDRESS;

if (1 == _RZN_ORDINAL)
{

    define symbol __region_DATA_NONCACHE_start__               = SYSTEM_RAM_ALIGN_START + SYSTEM_RAM_ALIGN_LENGTH + SYSTEM_RAM_MIRROR_OFFSET - DATA_NONCACHE_OFFSET;
    define symbol __region_DATA_NONCACHE_end__                 = SYSTEM_RAM_ALIGN_START + SYSTEM_RAM_ALIGN_LENGTH + SYSTEM_RAM_MIRROR_OFFSET - DATA_NONCACHE_END_OFFSET - 1;
    define symbol __region_DMAC_LINK_MODE_start__              = SYSTEM_RAM_ALIGN_START + SYSTEM_RAM_ALIGN_LENGTH + SYSTEM_RAM_MIRROR_OFFSET - DMAC_LINK_MODE_OFFSET;
    define symbol __region_DMAC_LINK_MODE_end__                = SYSTEM_RAM_ALIGN_START + SYSTEM_RAM_ALIGN_LENGTH + SYSTEM_RAM_MIRROR_OFFSET - DMAC_LINK_MODE_END_OFFSET - 1;
    define symbol __region_SHARED_NONCACHE_BUFFER_start__      = SYSTEM_RAM_ALIGN_START + SYSTEM_RAM_ALIGN_LENGTH + SYSTEM_RAM_MIRROR_OFFSET - SHARED_NONCACHE_BUFFER_OFFSET;
    define symbol __region_SHARED_NONCACHE_BUFFER_end__        = SYSTEM_RAM_ALIGN_START + SYSTEM_RAM_ALIGN_LENGTH + SYSTEM_RAM_MIRROR_OFFSET - SHARED_NONCACHE_BUFFER_END_OFFSET - 1;
    define symbol __region_NONCACHE_BUFFER_start__             = SYSTEM_RAM_ALIGN_START + SYSTEM_RAM_ALIGN_LENGTH + SYSTEM_RAM_MIRROR_OFFSET - NONCACHE_BUFFER_OFFSET;
    define symbol __region_NONCACHE_BUFFER_end__               = SYSTEM_RAM_ALIGN_START + SYSTEM_RAM_ALIGN_LENGTH + SYSTEM_RAM_MIRROR_OFFSET - NONCACHE_BUFFER_END_OFFSET - 1;

    define symbol __region_DATA_NONCACHE_INIT_start__          = SYSTEM_RAM_ALIGN_START + SYSTEM_RAM_ALIGN_LENGTH - DATA_NONCACHE_OFFSET;
    define symbol __region_DATA_NONCACHE_INIT_end__            = SYSTEM_RAM_ALIGN_START + SYSTEM_RAM_ALIGN_LENGTH - DATA_NONCACHE_END_OFFSET - 1;
    define symbol __region_DMAC_LINK_MODE_INIT_start__         = SYSTEM_RAM_ALIGN_START + SYSTEM_RAM_ALIGN_LENGTH - DMAC_LINK_MODE_OFFSET;
    define symbol __region_DMAC_LINK_MODE_INIT_end__           = SYSTEM_RAM_ALIGN_START + SYSTEM_RAM_ALIGN_LENGTH - DMAC_LINK_MODE_END_OFFSET - 1;
    define symbol __region_SHARED_NONCACHE_BUFFER_INIT_start__ = SYSTEM_RAM_ALIGN_START + SYSTEM_RAM_ALIGN_LENGTH - SHARED_NONCACHE_BUFFER_OFFSET;
    define symbol __region_SHARED_NONCACHE_BUFFER_INIT_end__   = SYSTEM_RAM_ALIGN_START + SYSTEM_RAM_ALIGN_LENGTH - SHARED_NONCACHE_BUFFER_END_OFFSET - 1;
    define symbol __region_NONCACHE_BUFFER_INIT_start__        = SYSTEM_RAM_ALIGN_START + SYSTEM_RAM_ALIGN_LENGTH - NONCACHE_BUFFER_OFFSET;
    define symbol __region_NONCACHE_BUFFER_INIT_end__          = SYSTEM_RAM_ALIGN_START + SYSTEM_RAM_ALIGN_LENGTH - NONCACHE_BUFFER_END_OFFSET - 1;

}
else
{
    if ((0 == HAS_SYSTEM_RAM_MIRROR) && (isdefinedsymbol(CR52_0) || isdefinedsymbol(CR52_1)))
    {
        define symbol __region_SHARED_NONCACHE_BUFFER_start__ = SYSTEM_RAM_ALIGN_START + SYSTEM_RAM_ALIGN_LENGTH - SHARED_NONCACHE_BUFFER_OFFSET;
        define symbol __region_SHARED_NONCACHE_BUFFER_end__   = SYSTEM_RAM_ALIGN_START + SYSTEM_RAM_ALIGN_LENGTH - SHARED_NONCACHE_BUFFER_END_OFFSET - 1;
    }
    else
    {
        define symbol __region_NONCACHE_start__               = SYSTEM_RAM_ALIGN_START + NONCACHE_OFFSET;
        define symbol __region_NONCACHE_end__                 = SYSTEM_RAM_ALIGN_START + NONCACHE_OFFSET + NONCACHE_LENGTH - 1;

        define symbol __region_SHARED_NONCACHE_BUFFER_start__ = SYSTEM_RAM_ALIGN_START + SYSTEM_RAM_ALIGN_LENGTH + SYSTEM_RAM_MIRROR_OFFSET - SHARED_NONCACHE_BUFFER_OFFSET;
        define symbol __region_SHARED_NONCACHE_BUFFER_end__   = SYSTEM_RAM_ALIGN_START + SYSTEM_RAM_ALIGN_LENGTH + SYSTEM_RAM_MIRROR_OFFSET - SHARED_NONCACHE_BUFFER_END_OFFSET - 1;
    }
}

define symbol __region_ATCM_start__              = ATCM_PRV_START;
define symbol __region_ATCM_end__                = ATCM_PRV_START + ATCM_PRV_LENGTH - 1;
define symbol __region_BTCM_start__              = BTCM_PRV_START;
define symbol __region_BTCM_end__                = BTCM_PRV_START + BTCM_PRV_LENGTH - 1;
define symbol __region_SYSTEM_RAM_start__        = SYSTEM_RAM_ALIGN_START;
define symbol __region_SYSTEM_RAM_end__          = SYSTEM_RAM_ALIGN_START + SYSTEM_RAM_ALIGN_LENGTH - 1;
define symbol __region_SYSTEM_RAM_MIRROR_start__ = SYSTEM_RAM_MIRROR_PRV_START;
define symbol __region_SYSTEM_RAM_MIRROR_end__   = SYSTEM_RAM_MIRROR_PRV_START + SYSTEM_RAM_MIRROR_PRV_LENGTH - 1;

define symbol __region_XSPI0_CS0_MIRROR_start__ = xSPI0_CS0_SPACE_MIRROR_PRV_START;
define symbol __region_XSPI0_CS0_MIRROR_end__   = xSPI0_CS0_SPACE_MIRROR_PRV_START + xSPI0_CS0_SPACE_MIRROR_PRV_LENGTH - 1;
define symbol __region_XSPI0_CS1_MIRROR_start__ = xSPI0_CS1_SPACE_MIRROR_PRV_START;
define symbol __region_XSPI0_CS1_MIRROR_end__   = xSPI0_CS1_SPACE_MIRROR_PRV_START + xSPI0_CS1_SPACE_MIRROR_PRV_LENGTH - 1;
define symbol __region_XSPI1_CS0_MIRROR_start__ = xSPI1_CS0_SPACE_MIRROR_PRV_START;
define symbol __region_XSPI1_CS0_MIRROR_end__   = xSPI1_CS0_SPACE_MIRROR_PRV_START + xSPI1_CS0_SPACE_MIRROR_PRV_LENGTH - 1;
define symbol __region_XSPI1_CS1_MIRROR_start__ = xSPI1_CS1_SPACE_MIRROR_PRV_START;
define symbol __region_XSPI1_CS1_MIRROR_end__   = xSPI1_CS1_SPACE_MIRROR_PRV_START + xSPI1_CS1_SPACE_MIRROR_PRV_LENGTH - 1;
define symbol __region_CS0_MIRROR_start__       = CS0_SPACE_MIRROR_PRV_START;
define symbol __region_CS0_MIRROR_end__         = CS0_SPACE_MIRROR_PRV_START + CS0_SPACE_MIRROR_PRV_LENGTH - 1;
define symbol __region_CS2_MIRROR_start__       = CS2_SPACE_MIRROR_PRV_START;
define symbol __region_CS2_MIRROR_end__         = CS2_SPACE_MIRROR_PRV_START + CS2_SPACE_MIRROR_PRV_LENGTH - 1;
define symbol __region_CS3_MIRROR_start__       = CS3_SPACE_MIRROR_PRV_START;
define symbol __region_CS3_MIRROR_end__         = CS3_SPACE_MIRROR_PRV_START + CS3_SPACE_MIRROR_PRV_LENGTH - 1;
define symbol __region_CS5_MIRROR_start__       = CS5_SPACE_MIRROR_PRV_START;
define symbol __region_CS5_MIRROR_end__         = CS5_SPACE_MIRROR_PRV_START + CS5_SPACE_MIRROR_PRV_LENGTH - 1;
define symbol __region_XSPI0_CS0_start__        = xSPI0_CS0_SPACE_PRV_START;
define symbol __region_XSPI0_CS0_end__          = xSPI0_CS0_SPACE_PRV_START + xSPI0_CS0_SPACE_PRV_LENGTH - 1;
define symbol __region_XSPI0_CS1_start__        = xSPI0_CS1_SPACE_PRV_START;
define symbol __region_XSPI0_CS1_end__          = xSPI0_CS1_SPACE_PRV_START + xSPI0_CS1_SPACE_PRV_LENGTH - 1;
define symbol __region_XSPI1_CS0_start__        = xSPI1_CS0_SPACE_PRV_START;
define symbol __region_XSPI1_CS0_end__          = xSPI1_CS0_SPACE_PRV_START + xSPI1_CS0_SPACE_PRV_LENGTH - 1;
define symbol __region_XSPI1_CS1_start__        = xSPI1_CS1_SPACE_PRV_START;
define symbol __region_XSPI1_CS1_end__          = xSPI1_CS1_SPACE_PRV_START + xSPI1_CS1_SPACE_PRV_LENGTH - 1;
define symbol __region_CS0_start__              = CS0_SPACE_PRV_START;
define symbol __region_CS0_end__                = CS0_SPACE_PRV_START + CS0_SPACE_PRV_LENGTH - 1;
define symbol __region_CS2_start__              = CS2_SPACE_PRV_START;
define symbol __region_CS2_end__                = CS2_SPACE_PRV_START + CS2_SPACE_PRV_LENGTH - 1;
define symbol __region_CS3_start__              = CS3_SPACE_PRV_START;
define symbol __region_CS3_end__                = CS3_SPACE_PRV_START + CS3_SPACE_PRV_LENGTH - 1;
define symbol __region_CS5_start__              = CS5_SPACE_PRV_START;
define symbol __region_CS5_end__                = CS5_SPACE_PRV_START + CS5_SPACE_PRV_LENGTH - 1;

define exported symbol __ddsc_ATCM_START = ATCM_PRV_START;
define exported symbol __ddsc_BTCM_START = BTCM_PRV_START;
define exported symbol __ddsc_SYSTEM_RAM_START = SYSTEM_RAM_ALIGN_START;

if ((1 == _RZN_ORDINAL) && isdefinedsymbol(CR52_0))
{
    define exported symbol __ddsc_SYSTEM_RAM_END = SYSTEM_RAM_ALIGN_START;
}
else
{
    define exported symbol __ddsc_ATCM_END = ATCM_PRV_START;
    define exported symbol __ddsc_BTCM_END = BTCM_PRV_START;
}

if (1 == _RZN_ORDINAL)
{
    define region DATA_NONCACHE_region               = mem:[from __region_DATA_NONCACHE_start__   to __region_DATA_NONCACHE_end__];
    define region DMAC_LINK_MODE_region              = mem:[from __region_DMAC_LINK_MODE_start__   to __region_DMAC_LINK_MODE_end__];
    define region SHARED_NONCACHE_BUFFER_region      = mem:[from __region_SHARED_NONCACHE_BUFFER_start__   to __region_SHARED_NONCACHE_BUFFER_end__];
    define region NONCACHE_BUFFER_region             = mem:[from __region_NONCACHE_BUFFER_start__   to __region_NONCACHE_BUFFER_end__];

    define region DATA_NONCACHE_INIT_region          = mem:[from __region_DATA_NONCACHE_INIT_start__   to __region_DATA_NONCACHE_INIT_end__];
    define region DMAC_LINK_MODE_INIT_region         = mem:[from __region_DMAC_LINK_MODE_INIT_start__   to __region_DMAC_LINK_MODE_INIT_end__];
    define region SHARED_NONCACHE_BUFFER_INIT_region = mem:[from __region_SHARED_NONCACHE_BUFFER_INIT_start__   to __region_SHARED_NONCACHE_BUFFER_INIT_end__];
    define region NONCACHE_BUFFER_INIT_region        = mem:[from __region_NONCACHE_BUFFER_INIT_start__   to __region_NONCACHE_BUFFER_INIT_end__];
}
else
{
    if ((0 == HAS_SYSTEM_RAM_MIRROR) && (isdefinedsymbol(CR52_0) || isdefinedsymbol(CR52_1)))
    {
        define region SHARED_NONCACHE_BUFFER_region     = mem:[from __region_SHARED_NONCACHE_BUFFER_start__   to __region_SHARED_NONCACHE_BUFFER_end__];
    }
    else
    {
        define region NONCACHE_region                   = mem:[from __region_NONCACHE_start__   to __region_NONCACHE_end__];
        define region SHARED_NONCACHE_BUFFER_region     = mem:[from __region_SHARED_NONCACHE_BUFFER_start__   to __region_SHARED_NONCACHE_BUFFER_end__];
    }
}

define region D_LOADER_STACK_region    = mem:[from __region_D_LOADER_STACK_start__   to __region_D_LOADER_STACK_end__];

define region ATCM_region              = mem:[from __region_ATCM_start__  to __region_ATCM_end__ ];
define region BTCM_region              = mem:[from __region_BTCM_start__  to __region_BTCM_end__ ];
define region SYSTEM_RAM_region        = mem:[from __region_SYSTEM_RAM_start__  to __region_SYSTEM_RAM_end__ ];
define region SYSTEM_RAM_MIRROR_region = mem:[from __region_SYSTEM_RAM_MIRROR_start__  to __region_SYSTEM_RAM_MIRROR_end__ ];
define region XSPI0_CS0_MIRROR_region  = mem:[from __region_XSPI0_CS0_MIRROR_start__  to __region_XSPI0_CS0_MIRROR_end__ ];
define region XSPI0_CS1_MIRROR_region  = mem:[from __region_XSPI0_CS1_MIRROR_start__  to __region_XSPI0_CS1_MIRROR_end__ ];
define region XSPI1_CS0_MIRROR_region  = mem:[from __region_XSPI1_CS0_MIRROR_start__  to __region_XSPI1_CS0_MIRROR_end__ ];
define region XSPI1_CS1_MIRROR_region  = mem:[from __region_XSPI1_CS1_MIRROR_start__  to __region_XSPI1_CS1_MIRROR_end__ ];
define region CS0_MIRROR_region        = mem:[from __region_CS0_MIRROR_start__  to __region_CS0_MIRROR_end__ ];
define region CS2_MIRROR_region        = mem:[from __region_CS2_MIRROR_start__  to __region_CS2_MIRROR_end__ ];
define region CS3_MIRROR_region        = mem:[from __region_CS3_MIRROR_start__  to __region_CS3_MIRROR_end__ ];
define region CS5_MIRROR_region        = mem:[from __region_CS5_MIRROR_start__  to __region_CS5_MIRROR_end__ ];
define region XSPI0_CS0_region         = mem:[from __region_XSPI0_CS0_start__  to __region_XSPI0_CS0_end__ ];
define region XSPI0_CS1_region         = mem:[from __region_XSPI0_CS1_start__  to __region_XSPI0_CS1_end__ ];
define region XSPI1_CS0_region         = mem:[from __region_XSPI1_CS0_start__  to __region_XSPI1_CS0_end__ ];
define region XSPI1_CS1_region         = mem:[from __region_XSPI1_CS1_start__  to __region_XSPI1_CS1_end__ ];
define region CS0_region               = mem:[from __region_CS0_start__  to __region_CS0_end__ ];
define region CS2_region               = mem:[from __region_CS2_start__  to __region_CS2_end__ ];
define region CS3_region               = mem:[from __region_CS3_start__  to __region_CS3_end__ ];
define region CS5_region               = mem:[from __region_CS5_start__  to __region_CS5_end__ ];

define block LDR_PRG_RBLOCK with fixed order, alignment = 8
                             { ro code section .loader_text object startup_core.o,
                               ro code object startup_core.o,
                               ro code object system_core.o,
                               ro code object startup.o,
                               ro code object system.o,
                               ro code object bsp_clocks.o,
                               ro code object bsp_irq_core.o,
                               ro code object bsp_irq.o,
                               ro code object bsp_semaphore.o,
                               ro code object bsp_register_protection.o,
                               ro code object r_ioport.o,
                               ro code object data_init.o,
                               ro code object copy_init3.o,
                               ro code object bsp_cache.o,
                               ro code object bsp_tzc400.o,
                               ro code object bsp_address_expander.o,
                               ro code section .warm_start }
                               except { section .intvec*,
                                        section .reset_handler };
define block LDR_DATA_ZBLOCK with alignment = 8
                             { section .bss object startup_core.o,
                               section .bss object system_core.o,
                               section .bss object startup.o,
                               section .bss object system.o,
                               section .bss object bsp_clocks.o,
                               section .bss object bsp_irq_core.o,
                               section .bss object bsp_irq.o,
                               section .bss object bsp_semaphore.o,
                               section .bss object bsp_register_protection.o,
                               section .bss object r_ioport.o,
                               section .bss object data_init.o,
                               section .bss object copy_init3.o,
                               section .bss object bsp_cache.o,
                               section .bss object bsp_tzc400.o,
                               section .bss object bsp_address_expander.o,
                               section .bss object bsp_io.o,
                               section .ttbr };
define block LDR_DATA_WBLOCK with fixed order, alignment = 8
                             { section .data object startup_core.o,
                               section .data object system_core.o,
                               section .data object startup.o,
                               section .data object system.o,
                               section .data object bsp_clocks.o,
                               section .data object bsp_irq_core.o,
                               section .data object bsp_irq.o,
                               section .data object bsp_semaphore.o,
                               section .data object bsp_register_protection.o,
                               section .data object r_ioport.o,
                               section .data object data_init.o,
                               section .data object copy_init3.o,
                               section .data object bsp_cache.o,
                               section .data object bsp_tzc400.o,
                               section .data object bsp_address_expander.o,
                               section .rodata object bsp_tzc400.o,
                               section .rodata object system_core.o,
                               section .rodata object bsp_register_protection.o };

define block HEAP_BLOCK with alignment = 8 { rw section HEAP };
define block THREAD_STACK with alignment = 8 { rw section .stack* };
define block AARCH64_STACK with alignment = 8 { rw section .aarch64_stack* };
define block SYS_STACK with alignment = 8 { rw section .sys_stack };
define block SVC_STACK with alignment = 8 { rw section .svc_stack };
define block IRQ_STACK with alignment = 8 { rw section .irq_stack };
define block FIQ_STACK with alignment = 8 { rw section .fiq_stack };
define block UND_STACK with alignment = 8 { rw section .und_stack };
define block ABT_STACK with alignment = 8 { rw section .abt_stack };

define block VECTOR_RBLOCK with fixed order
                           { block VECTOR_RBLOCK_0x000 with alignment = 0x20 { section .intvec },
                             block VECTOR_RBLOCK_0x080 with alignment = 0x80 { section .intvec_0x080 },
                             block VECTOR_RBLOCK_0x100 with alignment = 0x80 { section .intvec_0x100 },
                             block VECTOR_RBLOCK_0x180 with alignment = 0x80 { section .intvec_0x180 },
                             block VECTOR_RBLOCK_0x200 with alignment = 0x80 { section .intvec_0x200 },
                             block VECTOR_RBLOCK_0x280 with alignment = 0x80 { section .intvec_0x280 },
                             block VECTOR_RBLOCK_0x300 with alignment = 0x80 { section .intvec_0x300 },
                             block VECTOR_RBLOCK_0x380 with alignment = 0x80 { section .intvec_0x380 },
                             block VECTOR_RBLOCK_0x400 with alignment = 0x80 { section .intvec_0x400 },
                             block VECTOR_RBLOCK_0x480 with alignment = 0x80 { section .intvec_0x480 },
                             block VECTOR_RBLOCK_0x500 with alignment = 0x80 { section .intvec_0x500 },
                             block VECTOR_RBLOCK_0x580 with alignment = 0x80 { section .intvec_0x580 },
                             block VECTOR_RBLOCK_0x600 with alignment = 0x80 { section .intvec_0x600 },
                             block VECTOR_RBLOCK_0x680 with alignment = 0x80 { section .intvec_0x680 },
                             block VECTOR_RBLOCK_0x700 with alignment = 0x80 { section .intvec_0x700 },
                             block VECTOR_RBLOCK_0x780 with alignment = 0x80 { section .intvec_0x780 }};

define block USER_PRG_RBLOCK  { ro code };
define block USER_DATA_ZBLOCK { section .bss };
define block USER_DATA_WBLOCK with fixed order
                              { section .data,
                                section __DLIB_PERTHREAD };

if (1 == _RZN_ORDINAL)
{
    if (isdefinedsymbol(CR52_0))
    {
        define block ATCM_END_block { section .ddsc_atcm_end };
        define block BTCM_END_block { section .ddsc_btcm_end };
    }
    else
    {
        define block SYSTEM_RAM_END_block { section .ddsc_system_ram_end };
    }

    if ((0 == HAS_SYSTEM_RAM_MIRROR) && isdefinedsymbol(CR52_0))
    {
        define block USER_DATA_NONCACHE_ZBLOCK with alignment = 8 { zi section .data_noncache* };
        define block DMAC_LINK_MODE_ZBLOCK with alignment = 8 { zi section .dmac_link_mode* };
        define block SHARED_NONCACHE_BUFFER_ZBLOCK with alignment = 32 { zi section .shared_noncache_buffer* };
        define block NONCACHE_BUFFER_ZBLOCK with alignment = 32 { zi section .noncache_buffer* };

        define block USER_DATA_NONCACHE_WBLOCK with alignment = 64 { section .data_noncache* };
    }
    else
    {
        define block USER_DATA_NONCACHE_RBLOCK with alignment = 8 { section .data_noncache*_init };
        define block DMAC_LINK_MODE_RBLOCK with alignment = 8 { section .dmac_link_mode*_init };
        define block SHARED_NONCACHE_BUFFER_RBLOCK with alignment = 32 { section .shared_noncache_buffer*_init };
        define block NONCACHE_BUFFER_RBLOCK with alignment = 32 { section .noncache_buffer*_init };

        define block USER_DATA_NONCACHE_WBLOCK with alignment = 8 { section .data_noncache* };

        initialize manually { section .data_noncache*,
                              section .dmac_link_mode*,
                              section .shared_noncache_buffer*,
                              section .noncache_buffer* };
    }


    define block DMAC_LINK_MODE_WBLOCK with alignment = 8 { section .dmac_link_mode* };
    define block SHARED_NONCACHE_BUFFER_WBLOCK with alignment = 32 { section .shared_noncache_buffer* };
    define block NONCACHE_BUFFER_WBLOCK with alignment = 32 { section .noncache_buffer* };
}
else
{
    if ((0 == HAS_SYSTEM_RAM_MIRROR) && (isdefinedsymbol(CR52_0) || isdefinedsymbol(CR52_1)))
    {
        define block USER_DATA_NONCACHE_ZBLOCK with alignment = 8 { zi section .data_noncache* };
        define block DMAC_LINK_MODE_ZBLOCK with alignment = 8 { zi section .dmac_link_mode* };
        define block NONCACHE_BUFFER_ZBLOCK with alignment = 32 { zi section .noncache_buffer* };

        define block USER_DATA_NONCACHE_WBLOCK with alignment = 64 { section .data_noncache* };

        initialize manually { section .shared_noncache_buffer* };
    }
    else
    {
        define block USER_DATA_NONCACHE_RBLOCK with alignment = 8 { section .data_noncache*_init };
        define block DMAC_LINK_MODE_RBLOCK with alignment = 8 { section .dmac_link_mode*_init };
        define block NONCACHE_BUFFER_RBLOCK with alignment = 32 { section .noncache_buffer*_init };

        define block USER_DATA_NONCACHE_WBLOCK with alignment = 8 { section .data_noncache* };

        initialize by copy  { section .data_noncache*,
                              section .dmac_link_mode*,
                              section .noncache_buffer* };

        initialize manually { section .shared_noncache_buffer* };
    }

    define block SHARED_NONCACHE_BUFFER_ZBLOCK with alignment = 32 { zi section .shared_noncache_buffer* };
    define block SHARED_NONCACHE_BUFFER_RBLOCK with alignment = 32 { section .shared_noncache_buffer*_init };

    define block DMAC_LINK_MODE_WBLOCK with alignment = 8 { section .dmac_link_mode* };
    define block SHARED_NONCACHE_BUFFER_WBLOCK with alignment = 32 { section .shared_noncache_buffer* };
    define block NONCACHE_BUFFER_WBLOCK with alignment = 32 { section .noncache_buffer* };

    define block SYSTEM_RAM_END_block { section .ddsc_system_ram_end };

}

do not initialize  { section .noinit,
                     section .bss object startup_core.o,
                     section .bss object system_core.o,
                     section .bss object startup.o,
                     section .bss object system.o,
                     section .bss object bsp_clocks.o,
                     section .bss object bsp_irq_core.o,
                     section .bss object bsp_irq.o,
                     section .bss object bsp_semaphore.o,
                     section .bss object bsp_register_protection.o,
                     section .bss object r_ioport.o,
                     section .bss object bsp_cache.o,
                     section .bss object bsp_tzc400.o,
                     section .bss object bsp_address_expander.o,
                     section .ttbr,
                     section .ddsc_atcm_end,
                     section .ddsc_btcm_end,
                     section .ddsc_system_ram_end,
                     zi section .data_noncache*,
                     zi section .dmac_link_mode*,
                     zi section .noncache_buffer*,
                     zi section .shared_noncache_buffer*,
                     rw section HEAP,
                     rw section .aarch64_stack*,
                     rw section .stack*,
                     rw section .sys_stack,
                     rw section .svc_stack,
                     rw section .irq_stack,
                     rw section .fiq_stack,
                     rw section .und_stack,
                     rw section .abt_stack };

if (1 == _RZN_ORDINAL)
{
    place at address mem: __ICFEDIT_intvec_start__ { block VECTOR_RBLOCK };

    place at start of D_LOADER_STACK_region { block LDR_PRG_RBLOCK };
    place in D_LOADER_STACK_region          { section LDR_DATA_WBLOCK, block LDR_DATA_WBLOCK,
                                              section LDR_DATA_ZBLOCK, block LDR_DATA_ZBLOCK };
    place in D_LOADER_STACK_region          { section SYS_STACK, block SYS_STACK,
                                              section SVC_STACK, block SVC_STACK,
                                              section IRQ_STACK, block IRQ_STACK,
                                              section FIQ_STACK, block FIQ_STACK,
                                              section UND_STACK, block UND_STACK,
                                              section ABT_STACK, block ABT_STACK };

    place at start of RAM_region            { block USER_PRG_RBLOCK,
                                              readonly };
    place in RAM_region                     { readwrite };
    place in RAM_region                     { block USER_DATA_WBLOCK,
                                              block USER_DATA_ZBLOCK };
    place in RAM_region                     { section HEAP_BLOCK, block HEAP_BLOCK,
                                              section THREAD_STACK, block THREAD_STACK,
                                              section AARCH64_STACK, block AARCH64_STACK };

    if (isdefinedsymbol(CR52_0))
    {
        place in D_LOADER_STACK_region { last block BTCM_END_block };
        place in RAM_region { last block ATCM_END_block };
    }
    else
    {
        place in RAM_region { last block SYSTEM_RAM_END_block };
    }

    if ((0 == HAS_SYSTEM_RAM_MIRROR) && isdefinedsymbol(CR52_0))
    {
        place at start of DATA_NONCACHE_INIT_region          { block USER_DATA_NONCACHE_WBLOCK };
        place in DATA_NONCACHE_INIT_region                   { block USER_DATA_NONCACHE_ZBLOCK };

        place at start of DMAC_LINK_MODE_INIT_region         { block DMAC_LINK_MODE_WBLOCK };
        place in DMAC_LINK_MODE_INIT_region                  { block DMAC_LINK_MODE_ZBLOCK };

        place at start of SHARED_NONCACHE_BUFFER_INIT_region { block SHARED_NONCACHE_BUFFER_WBLOCK };
        place in SHARED_NONCACHE_BUFFER_INIT_region          { block SHARED_NONCACHE_BUFFER_ZBLOCK };

        place at start of NONCACHE_BUFFER_INIT_region        { block NONCACHE_BUFFER_WBLOCK };
        place in NONCACHE_BUFFER_INIT_region                 { block NONCACHE_BUFFER_ZBLOCK };
    }
    else
    {
        place at start of DATA_NONCACHE_region               { block USER_DATA_NONCACHE_WBLOCK };
        place at start of DMAC_LINK_MODE_region              { block DMAC_LINK_MODE_WBLOCK };
        place at start of SHARED_NONCACHE_BUFFER_region      { block SHARED_NONCACHE_BUFFER_WBLOCK };
        place at start of NONCACHE_BUFFER_region             { block NONCACHE_BUFFER_WBLOCK };

        place at start of DATA_NONCACHE_INIT_region          { block USER_DATA_NONCACHE_RBLOCK };
        place at start of DMAC_LINK_MODE_INIT_region         { block DMAC_LINK_MODE_RBLOCK };
        place at start of SHARED_NONCACHE_BUFFER_INIT_region { block SHARED_NONCACHE_BUFFER_RBLOCK };
        place at start of NONCACHE_BUFFER_INIT_region        { block NONCACHE_BUFFER_RBLOCK };
    }
}
else
{
    place at address mem: __ICFEDIT_intvec_start__ { block VECTOR_RBLOCK };

    place at start of D_LOADER_STACK_region { block LDR_PRG_RBLOCK };
    place in D_LOADER_STACK_region          { section LDR_DATA_WBLOCK, block LDR_DATA_WBLOCK,
                                              section LDR_DATA_ZBLOCK, block LDR_DATA_ZBLOCK };
    place in D_LOADER_STACK_region          { section SYS_STACK, block SYS_STACK,
                                              section SVC_STACK, block SVC_STACK,
                                              section IRQ_STACK, block IRQ_STACK,
                                              section FIQ_STACK, block FIQ_STACK,
                                              section UND_STACK, block UND_STACK,
                                              section ABT_STACK, block ABT_STACK };

    if ((0 == HAS_SYSTEM_RAM_MIRROR) && (isdefinedsymbol(CR52_0) || isdefinedsymbol(CR52_1)))
    {
        place at start of RAM_region { block USER_PRG_RBLOCK,
                                       readonly,
                                       block SHARED_NONCACHE_BUFFER_RBLOCK };
        place in RAM_region          { readwrite };
        place in RAM_region          { block USER_DATA_WBLOCK,
                                       block USER_DATA_ZBLOCK };
        place in RAM_region          { section HEAP_BLOCK, block HEAP_BLOCK,
                                       section THREAD_STACK, block THREAD_STACK,
                                       section AARCH64_STACK, block AARCH64_STACK };
        place in RAM_region          { block USER_DATA_NONCACHE_WBLOCK,
                                       block DMAC_LINK_MODE_WBLOCK,
                                       last block NONCACHE_BUFFER_WBLOCK };
        place in RAM_region          { block USER_DATA_NONCACHE_ZBLOCK,
                                       block DMAC_LINK_MODE_ZBLOCK,
                                       last block NONCACHE_BUFFER_ZBLOCK };
        place in RAM_region          { last block SYSTEM_RAM_END_block };
    }
    else
    {

        place in NONCACHE_region with mirroring to (__region_NONCACHE_start__ + SYSTEM_RAM_MIRROR_OFFSET)
                            { block USER_DATA_NONCACHE_WBLOCK,
                              block DMAC_LINK_MODE_WBLOCK,
                              block NONCACHE_BUFFER_WBLOCK };

        place in RAM_region { block USER_PRG_RBLOCK,
                              readonly,
                              block USER_DATA_NONCACHE_RBLOCK,
                              block DMAC_LINK_MODE_RBLOCK,
                              block NONCACHE_BUFFER_RBLOCK,
                              block SHARED_NONCACHE_BUFFER_RBLOCK };
        place in RAM_region { readwrite };
        place in RAM_region { block USER_DATA_WBLOCK,
                              block USER_DATA_ZBLOCK };
        place in RAM_region { section HEAP_BLOCK, block HEAP_BLOCK,
                              section THREAD_STACK, block THREAD_STACK,
                              section AARCH64_STACK, block AARCH64_STACK,
                              last block SYSTEM_RAM_END_block };
    }

    place at start of SHARED_NONCACHE_BUFFER_region { block SHARED_NONCACHE_BUFFER_WBLOCK,
                                                      block SHARED_NONCACHE_BUFFER_ZBLOCK };
}

place in ATCM_region { };
place in BTCM_region { };
place in SYSTEM_RAM_region { };
place in SYSTEM_RAM_MIRROR_region { };
place in XSPI0_CS0_MIRROR_region { };
place in XSPI0_CS1_MIRROR_region { };
place in XSPI1_CS0_MIRROR_region { };
place in XSPI1_CS1_MIRROR_region { };
place in CS0_MIRROR_region { };
place in CS2_MIRROR_region { };
place in CS3_MIRROR_region { };
place in CS5_MIRROR_region { };
place in XSPI0_CS0_region { };
place in XSPI0_CS1_region { };
place in XSPI1_CS0_region { };
place in XSPI1_CS1_region { };
place in CS0_region { };
place in CS2_region { };
place in CS3_region { };
place in CS5_region { };